/* Copyright (c) 2013, The Linux Foundation. All rights reserved.
 *
 * This program is free software; you can redistribute it and/or modify
 * it under the terms of the GNU General Public License version 2 and
 * only version 2 as published by the Free Software Foundation.
 *
 * This program is distributed in the hope that it will be useful,
 * but WITHOUT ANY WARRANTY; without even the implied warranty of
 * MERCHANTABILITY or FITNESS FOR A PARTICULAR PURPOSE.  See the
 * GNU General Public License for more details.
 */

/*---------------------------------------------------------------------------
 * This file is autogenerated file using gcdb parser. Please do not edit it.
 * Update input XML file to add a new entry or update variable in this file
 * VERSION = "1.0"
 *---------------------------------------------------------------------------*/
&mdss_mdp { 
	dsi_oppo14027truly_720p_4lane_video: qcom,mdss_dsi_oppo14027truly_720p_4lane_video {
		qcom,mdss-dsi-panel-name = "oppo14027truly 720p_4lane video mode dsi panel";
		qcom,mdss-dsi-panel-controller = <&mdss_dsi0>;
		qcom,mdss-dsi-panel-type = "dsi_video_mode";
		qcom,mdss-dsi-panel-destination = "display_1";
		qcom,mdss-dsi-panel-framerate = <60>;
		qcom,mdss-dsi-virtual-channel-id = <0>;
		qcom,mdss-dsi-stream = <0>;
		qcom,mdss-dsi-panel-width = <720>;
		qcom,mdss-dsi-panel-height = <1280>;
		qcom,mdss-dsi-h-front-porch = <79>;
		qcom,mdss-dsi-h-back-porch = <59>;
		qcom,mdss-dsi-h-pulse-width = <60>;
		qcom,mdss-dsi-h-sync-skew = <0>;
		qcom,mdss-dsi-v-back-porch = <10>;
		qcom,mdss-dsi-v-front-porch = <7>;
		qcom,mdss-dsi-v-pulse-width = <2>;
		qcom,mdss-dsi-h-left-border = <0>;
		qcom,mdss-dsi-h-right-border = <0>;
		qcom,mdss-dsi-v-top-border = <0>;
		qcom,mdss-dsi-v-bottom-border = <0>;
		qcom,mdss-dsi-bpp = <24>;
		qcom,mdss-dsi-color-order = <0>;
		qcom,mdss-dsi-underflow-color = <0xff>;
		qcom,mdss-dsi-border-color = <0>;
		qcom,mdss-dsi-on-command = [39 01 00 00 00 00 06 F0 55 AA 52 08 00
		39 01 00 00 00 00 05 FF AA 55 A5 80
		39 01 00 00 00 00 03 6F 11 00
		39 01 00 00 00 00 03 F7 20 00
		39 01 00 00 00 00 02 6F 01
		39 01 00 00 00 00 02 B1 21
		39 01 00 00 00 00 06 BD 01 A0 10 08 01
		39 01 00 00 00 00 05 B8 01 02 04 02
		39 01 00 00 00 00 03 BB 11 11
		39 01 00 00 00 00 03 BC 00 00
		39 01 00 00 00 00 02 B6 02
		39 01 00 00 00 00 06 F0 55 AA 52 08 01
		39 01 00 00 00 00 03 B0 09 09
		39 01 00 00 00 00 03 B1 09 09
		39 01 00 00 00 00 03 BC 8C 00
		39 01 00 00 00 00 03 BD 8C 00
		39 01 00 00 00 00 02 CA 00
		39 01 00 00 00 00 02 C0 0C
		39 01 00 00 00 00 02 BE 98
		39 01 00 00 00 00 03 B3 26 26
		39 01 00 00 00 00 03 B4 1d 1d
		39 01 00 00 00 00 03 B9 24 24
		39 01 00 00 00 00 03 BA 34 34
		39 01 00 00 00 00 06 F0 55 AA 52 08 02
		39 01 00 00 00 00 02 EE 01
		39 01 00 00 00 00 11 B0 00 00 00 17 00 36 00 50 00 66 00 88 00 A5 00 D2
		39 01 00 00 00 00 11 B1 00 F8 01 35 01 66 01 B3 01 F2 01 F4 02 2F 02 6E
		39 01 00 00 00 00 11 B2 02 96 02 CB 02 EF 03 1C 03 3A 03 5E 03 75 03 91
		39 01 00 00 00 00 05 B3 03 B1 03 FF
		39 01 00 00 00 00 06 F0 55 AA 52 08 03
		39 01 00 00 00 00 03 B0 22 00
		39 01 00 00 00 00 03 B1 22 00
		39 01 00 00 00 00 06 B2 05 00 B0 00 00
		39 01 00 00 00 00 06 B3 05 00 B0 00 00
		39 01 00 00 00 00 06 B4 05 00 B0 00 00
		39 01 00 00 00 00 06 B5 05 00 B0 00 00
		39 01 00 00 00 00 06 BA 53 00 B0 00 00
		39 01 00 00 00 00 06 BB 53 00 B0 00 00
		39 01 00 00 00 00 06 BC 53 00 B0 00 00
		39 01 00 00 00 00 06 BD 53 00 B0 00 00
		39 01 00 00 00 00 05 C0 00 60 00 00
		39 01 00 00 00 00 05 C1 00 00 60 00
		39 01 00 00 00 00 05 C2 00 00 34 00
		39 01 00 00 00 00 05 C3 00 00 34 00
		39 01 00 00 00 00 02 C4 60
		39 01 00 00 00 00 02 C5 C0
		39 01 00 00 00 00 02 C6 00
		39 01 00 00 00 00 02 C7 00
		39 01 00 00 00 00 06 F0 55 AA 52 08 05
		39 01 00 00 00 00 03 B0 17 06
		39 01 00 00 00 00 03 B1 17 06
		39 01 00 00 00 00 03 B2 17 06
		39 01 00 00 00 00 03 B3 17 06
		39 01 00 00 00 00 03 B4 17 06
		39 01 00 00 00 00 03 B5 17 06
		39 01 00 00 00 00 03 B6 17 06
		39 01 00 00 00 00 03 B7 00 06
		39 01 00 00 00 00 02 B8 00
		39 01 00 00 00 00 03 B9 00 03
		39 01 00 00 00 00 03 BA 00 00
		39 01 00 00 00 00 03 BB 02 03
		39 01 00 00 00 00 03 BC 02 03
		39 01 00 00 00 00 06 BD 03 03 00 03 03
		39 01 00 00 00 00 02 C0 0B
		39 01 00 00 00 00 02 C1 09
		39 01 00 00 00 00 02 C2 A6
		39 01 00 00 00 00 02 C3 05
		39 01 00 00 00 00 02 C4 00
		39 01 00 00 00 00 02 C5 02
		39 01 00 00 00 00 02 C6 22
		39 01 00 00 00 00 02 C7 03
		39 01 00 00 00 00 03 C8 07 20
		39 01 00 00 00 00 03 C9 03 20
		39 01 00 00 00 00 03 CA 01 60
		39 01 00 00 00 00 03 CB 01 60
		39 01 00 00 00 00 04 CC 00 00 02
		39 01 00 00 00 00 04 CD 00 00 02
		39 01 00 00 00 00 04 CE 00 00 02
		39 01 00 00 00 00 04 CF 00 00 02
		39 01 00 00 00 00 06 D1 00 05 01 07 10
		39 01 00 00 00 00 06 D2 10 05 05 03 10
		39 01 00 00 00 00 06 D3 20 00 43 07 10
		39 01 00 00 00 00 06 D4 30 00 43 07 10
		39 01 00 00 00 00 08 D6 00 00 00 00 00 00 00
		39 01 00 00 00 00 0C D5 00 00 00 00 00 00 00 00 00 00 00
		39 01 00 00 00 00 0C D6 00 00 00 00 00 00 00 00 00 00 00
		39 01 00 00 00 00 0C D7 00 00 00 00 00 00 00 00 00 00 00
		39 01 00 00 00 00 06 D8 00 00 00 00 00
		39 01 00 00 00 00 02 E5 06
		39 01 00 00 00 00 02 E6 06
		39 01 00 00 00 00 02 E7 00
		39 01 00 00 00 00 02 E8 06
		39 01 00 00 00 00 02 E9 06
		39 01 00 00 00 00 02 EA 06
		39 01 00 00 00 00 02 EB 00
		39 01 00 00 00 00 02 EC 00
		39 01 00 00 00 00 02 ED 30
		39 01 00 00 00 00 06 F0 55 AA 52 08 06
		39 01 00 00 00 00 03 B0 34 34
		39 01 00 00 00 00 03 B1 34 34
		39 01 00 00 00 00 03 B2 2D 2E
		39 01 00 00 00 00 03 B3 34 34
		39 01 00 00 00 00 03 B4 29 2A
		39 01 00 00 00 00 03 B5 12 10
		39 01 00 00 00 00 03 B6 18 16
		39 01 00 00 00 00 03 B7 00 02
		39 01 00 00 00 00 03 B8 34 31
		39 01 00 00 00 00 03 B9 31 31
		39 01 00 00 00 00 03 BA 31 31
		39 01 00 00 00 00 03 BB 31 34
		39 01 00 00 00 00 03 BC 03 01
		39 01 00 00 00 00 03 BD 17 19
		39 01 00 00 00 00 03 BE 11 13
		39 01 00 00 00 00 03 BF 2A 29
		39 01 00 00 00 00 03 C0 34 34
		39 01 00 00 00 00 03 C1 2E 2D
		39 01 00 00 00 00 03 C2 34 34
		39 01 00 00 00 00 03 C3 34 34
		39 01 00 00 00 00 03 C4 34 34
		39 01 00 00 00 00 03 C5 34 34
		39 01 00 00 00 00 03 C6 2E 2D
		39 01 00 00 00 00 03 C7 34 34
		39 01 00 00 00 00 03 C8 29 2A
		39 01 00 00 00 00 03 C9 17 19
		39 01 00 00 00 00 03 CA 11 13
		39 01 00 00 00 00 03 CB 03 01
		39 01 00 00 00 00 03 CC 34 31
		39 01 00 00 00 00 03 CD 31 31
		39 01 00 00 00 00 03 CE 31 31
		39 01 00 00 00 00 03 CF 31 34
		39 01 00 00 00 00 03 D0 00 02
		39 01 00 00 00 00 03 D1 12 10
		39 01 00 00 00 00 03 D2 18 16
		39 01 00 00 00 00 03 D3 2A 29
		39 01 00 00 00 00 03 D4 34 34
		39 01 00 00 00 00 03 D5 2D 2E
		39 01 00 00 00 00 03 D6 34 34
		39 01 00 00 00 00 03 D7 34 34
		39 01 00 00 00 00 06 D8 00 00 00 00 00
		39 01 00 00 00 00 06 D9 00 00 00 00 00
		39 01 00 00 00 00 03 E6 31 31
		39 01 00 00 00 00 02 E7 00
		15 01 00 00 00 00 02 35 00
		05 01 00 00 78 00 02 11 00
		05 01 00 00 32 00 02 29 00];
		qcom,mdss-dsi-off-command = [05 01 00 00 32 00 02 28 00
					05 01 00 00 78 00 02 10 00];
		qcom,mdss-dsi-on-command-state = "dsi_lp_mode";
		qcom,mdss-dsi-off-command-state = "dsi_hs_mode";
		qcom,mdss-dsi-h-sync-pulse = <1>;
		qcom,mdss-dsi-traffic-mode = "burst_mode";
		qcom,mdss-dsi-lane-map = <0>;
		qcom,mdss-dsi-bllp-eof-power-mode;
		qcom,mdss-dsi-bllp-power-mode;
		qcom,mdss-dsi-lane-0-state;
		qcom,mdss-dsi-lane-1-state;
		qcom,mdss-dsi-lane-2-state;
		qcom,mdss-dsi-lane-3-state;
		qcom,mdss-dsi-panel-timings = [72 1A 1A 00 3E 68 16 1E 14 03 04 00];
		qcom,mdss-dsi-t-clk-post = <0x20>;
		qcom,mdss-dsi-t-clk-pre = <0x2c>;
		qcom,mdss-dsi-bl-min-level = <1>;
		qcom,mdss-dsi-bl-max-level = <255>;
		qcom,mdss-dsi-dma-trigger = <4>;
		qcom,mdss-dsi-mdp-trigger = <0>;
		qcom,mdss-dsi-bl-pmic-control-type = "bl_ctrl_wled";
		qcom,mdss-dsi-reset-sequence = <1 10>, <0 1>, <1 15>;
		qcom,mdss-pan-physical-width-dimension = <59>;
		qcom,mdss-pan-physical-height-dimension = <104>;

	};
};
