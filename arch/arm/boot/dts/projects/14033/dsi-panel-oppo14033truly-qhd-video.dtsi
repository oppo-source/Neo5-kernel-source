/* Copyright (c) 2013, The Linux Foundation. All rights reserved.
 *
 * This program is free software; you can redistribute it and/or modify
 * it under the terms of the GNU General Public License version 2 and
 * only version 2 as published by the Free Software Foundation.
 *
 * This program is distributed in the hope that it will be useful,
 * but WITHOUT ANY WARRANTY; without even the implied warranty of
 * MERCHANTABILITY or FITNESS FOR A PARTICULAR PURPOSE.  See the
 * GNU General Public License for more details.
 */

/*---------------------------------------------------------------------------
 * This file is autogenerated file using gcdb parser. Please do not edit it.
 * Update input XML file to add a new entry or update variable in this file
 * VERSION = "1.0"
 *---------------------------------------------------------------------------*/
&mdss_mdp {
	dsi_oppo14033truly_qhd_video: qcom,mdss_dsi_oppo14033truly_qhd_video {
		qcom,mdss-dsi-panel-name = "oppo14033truly qhd video mode dsi panel";
		qcom,mdss-dsi-panel-controller = <&mdss_dsi0>;
		qcom,mdss-dsi-panel-type = "dsi_video_mode";
		qcom,mdss-dsi-panel-destination = "display_1";
		qcom,mdss-dsi-panel-framerate = <60>;
		qcom,mdss-dsi-virtual-channel-id = <0>;
		qcom,mdss-dsi-stream = <0>;
		qcom,mdss-dsi-panel-width = <540>;
		qcom,mdss-dsi-panel-height = <960>;
		qcom,mdss-dsi-h-front-porch = <60>;
		qcom,mdss-dsi-h-back-porch = <39>;
		qcom,mdss-dsi-h-pulse-width = <39>;
		qcom,mdss-dsi-h-sync-skew = <0>;
		qcom,mdss-dsi-v-back-porch = <8>;
		qcom,mdss-dsi-v-front-porch = <9>;
		qcom,mdss-dsi-v-pulse-width = <3>;
		qcom,mdss-dsi-h-left-border = <0>;
		qcom,mdss-dsi-h-right-border = <0>;
		qcom,mdss-dsi-v-top-border = <0>;
		qcom,mdss-dsi-v-bottom-border = <0>;
		qcom,mdss-dsi-bpp = <24>;
		qcom,mdss-dsi-color-order = <0>;
		qcom,mdss-dsi-underflow-color = <0xff>;
		qcom,mdss-dsi-border-color = <0>;
		qcom,mdss-dsi-on-command = [39 01 00 00 00 00 04 B9 FF 83 89
				39 01 00 00 00 00 04 DE 05 58 10
				39 01 00 00 00 00 03 BA 01 92 
				39 01 00 00 00 00 14 B1 00 00 04 E3 96 10 11 6F EF 28 30 23 23 42 00 58 F7 20 00
				39 01 00 00 00 00 08 B2 00 00 78 08 03 00 80
				39 01 00 00 00 00 18 B4 80 08 00 32 10 00 00 00 00 00 00 00 37 0A 40 04 37 0A 40 14 50 55 0A
				39 01 00 00 00 00 1E D5 00 00 00 00 01 00 00 00 60 00 99 88 99 88 88 32 88 10 88 76 88 54 10 32 88 88 88 88 88
				39 01 00 00 00 00 23 E0 05 0D 11 2D 34 3F 1B 3A 06 0C 0D 11 12 11 12 13 15 05 0D 11 2D 34 3F 1B 3A 06 0C 0D 11 12 11 12 13 15
				39 01 00 00 00 00 80 C1 01 02 08 0F 1B 22 2A 31 37 3F 45 4D 54 5C 64 6C 73 7B 82 8B 93 9C A2 A9 B1 B9 C3 CA D1 D9 E1 E7 F0 F7 25 E7 73 F7 71 2E 8C 39 C0 02 08 0F 1B 23 2B 31 38 40 46 4E 56 5E 66 6D 75 7D 84 8C 95 9D  A4 AC B3 BC C6 CC D3 DC E4 EA F3 FA 2A 4E 30 88 3E 63 9F 4E C0 02 08 10 1B 23 2B 32 39 40 48 4F 57 5F 67 6F 77 7F 87 8F 98 9F A6 AE B6 C0 C9 CF D7 E0 E6 EF F7 FF 37 E8 85 B8 84 FF 99 B1 C0 
				39 01 00 00 00 00 02 CC 02												
				39 01 00 00 00 00 05 B6 00 A0 00 A0	
				39 01 00 00 00 00 03 CB 07 07
                39 01 00 00 00 00 05 BB 00 00 FF 80
                39 01 00 00 00 00 02 C6 08
                39 01 00 00 00 00 02 35 00
                05 01 00 00 78 00 02 11 00		
	        05 01 00 00 32 00 02 29 00];
		qcom,mdss-dsi-off-command = [05 01 00 00 32 00 02 28 00
				 05 01 00 00 78 00 02 10 00];
		qcom,mdss-dsi-on-command-state = "dsi_lp_mode";
		qcom,mdss-dsi-off-command-state = "dsi_hs_mode";
		qcom,mdss-dsi-h-sync-pulse = <1>;
		qcom,mdss-dsi-traffic-mode = "burst_mode";
		qcom,mdss-dsi-lane-map = <0>;
		qcom,mdss-dsi-bllp-eof-power-mode;
		qcom,mdss-dsi-bllp-power-mode;
		qcom,mdss-dsi-lane-0-state;
		qcom,mdss-dsi-lane-1-state;
		qcom,mdss-dsi-panel-timings = [86 1E 14 00 42 46 18 20 16 03 04 00];
		qcom,mdss-dsi-t-clk-post = <0x20>;
		qcom,mdss-dsi-t-clk-pre = <0x2c>;
		qcom,mdss-dsi-bl-min-level = <1>;
		qcom,mdss-dsi-bl-max-level = <255>;
		qcom,mdss-dsi-dma-trigger = <4>;
		qcom,mdss-dsi-mdp-trigger = <0>;
		qcom,mdss-dsi-bl-pmic-control-type = "bl_ctrl_wled";
		qcom,mdss-dsi-reset-sequence = <1 20>, <0 20>, <1 20>;
		qcom,mdss-pan-physical-width-dimension = <59>;
		qcom,mdss-pan-physical-height-dimension = <104>;
	};
};
