/* Copyright (c) 2013, The Linux Foundation. All rights reserved.
 *
 * This program is free software; you can redistribute it and/or modify
 * it under the terms of the GNU General Public License version 2 and
 * only version 2 as published by the Free Software Foundation.
 *
 * This program is distributed in the hope that it will be useful,
 * but WITHOUT ANY WARRANTY; without even the implied warranty of
 * MERCHANTABILITY or FITNESS FOR A PARTICULAR PURPOSE.  See the
 * GNU General Public License for more details.
 */

/*---------------------------------------------------------------------------
 * This file is autogenerated file using gcdb parser. Please do not edit it.
 * Update input XML file to add a new entry or update variable in this file
 * VERSION = "1.0"
 *---------------------------------------------------------------------------*/
&mdss_mdp {
	dsi_oppo13095truly_hx8394a_720p_video: qcom,mdss_dsi_oppo13095truly_hx8394a_720p_video {
		qcom,mdss-dsi-panel-name = "oppo13095truly hx8394a 720p video mode dsi panel";
		qcom,mdss-dsi-panel-controller = <&mdss_dsi0>;
		qcom,mdss-dsi-panel-type = "dsi_video_mode";
		qcom,mdss-dsi-panel-destination = "display_1";
		qcom,mdss-dsi-panel-framerate = <60>;
		qcom,mdss-dsi-virtual-channel-id = <0>;
		qcom,mdss-dsi-stream = <0>;
		qcom,mdss-dsi-panel-width = <720>;
		qcom,mdss-dsi-panel-height = <1280>;
		qcom,mdss-dsi-h-front-porch = <146>;
		qcom,mdss-dsi-h-back-porch = <153>;
		qcom,mdss-dsi-h-pulse-width = <16>;
		qcom,mdss-dsi-h-sync-skew = <0>;
		qcom,mdss-dsi-v-back-porch = <9>;
		qcom,mdss-dsi-v-front-porch = <19>;
		qcom,mdss-dsi-v-pulse-width = <1>;
		qcom,mdss-dsi-h-left-border = <0>;
		qcom,mdss-dsi-h-right-border = <0>;
		qcom,mdss-dsi-v-top-border = <0>;
		qcom,mdss-dsi-v-bottom-border = <0>;
		qcom,mdss-dsi-bpp = <24>;
		qcom,mdss-dsi-color-order = <0>;
		qcom,mdss-dsi-underflow-color = <0xff>;
		qcom,mdss-dsi-border-color = <0>;
		qcom,mdss-dsi-on-command = [39 01 00 00 00 00 04 B9 FF 83 94
39 01 00 00 00 00 02 BA 13
39 01 00 00 00 00 11 B1 01 00 47 83 01 0E 0E 27 30 3F 3F 47 12 01 E6 E2
39 01 00 00 00 00 17 B4 80 06 32 10 03 32 15 08 32 10 08 33 04 43 05 37 04 3F 06 61 61 06
39 01 00 00 00 00 07 B2 00 C8 08 04 00 22
39 01 00 00 00 00 21 D5 00 00 00 00 0A 00 01 00 CC00 00 00 88 88 88 88 88 88 88 88 88 88 01 67 45 23 01 23 88 88 88 88
39 01 00 00 00 00 05 C7 00 10 00 10
39 01 00 00 00 00 05 BF 06 00 10 04
39 01 00 00 00 00 02 CC 09
39 01 00 00 00 00 2B E0 00 05 08 2B 33 3F 15 36 07 0D 0E 11 12 11 12 10 17 00 05 08 2B 33 3F 15 36 07 0D 0E 11 12 11 12 10 17 0B 17 06 11 0B 17 06 11
39 01 00 00 00 00 03 BF 06 02
39 01 00 00 00 00 02 B6 EC
39 01 00 00 00 00 02 D4 32
39 01 00 00 00 00 02 35 00
05 01 00 00 96 00 02 11 00
05 01 00 00 40 00 02 29 00];
		qcom,mdss-dsi-on-command-cabc =  [39 01 00 00 00 00 04 B9 FF 83 94
39 01 00 00 00 00 02 BA 13
39 01 00 00 00 00 11 B1 01 00 47 83 01 0E 0E 27 30 3F 3F 47 12 01 E6 E2
39 01 00 00 00 00 17 B4 80 06 32 10 03 32 15 08 32 10 08 33 04 43 05 37 04 3F 06 61 61 06
39 01 00 00 00 00 07 B2 00 C8 08 04 00 22
39 01 00 00 00 00 21 D5 00 00 00 00 0A 00 01 00 CC00 00 00 88 88 88 88 88 88 88 88 88 88 01 67 45 23 01 23 88 88 88 88
39 01 00 00 00 00 05 C7 00 10 00 10
39 01 00 00 00 00 05 BF 06 00 10 04
39 01 00 00 00 00 02 CC 09
39 01 00 00 00 00 2B E0 00 05 08 2B 33 3F 15 36 07 0D 0E 11 12 11 12 10 17 00 05 08 2B 33 3F 15 36 07 0D 0E 11 12 11 12 10 17 0B 17 06 11 0B 17 06 11
39 01 00 00 00 00 03 BF 06 02
39 01 00 00 00 00 02 B6 EC
39 01 00 00 00 00 02 D4 32
39 01 00 00 01 00 02 51 ff
39 01 00 00 01 00 02 55 03
15 01 00 00 01 00 02 53 2c
39 01 00 00 00 00 02 35 00
05 01 00 00 96 00 02 11 00
05 01 00 00 40 00 02 29 00];
		qcom,mdss-dsi-off-command = [05 01 00 00 14 00 02 28 00
					05 01 00 00 78 00 02 10 00];
		qcom,mdss-dsi-on-command-state = "dsi_lp_mode";
		qcom,mdss-dsi-off-command-state = "dsi_hs_mode";
				/*caven.han add begin for CABC*/
		qcom,mdss-dsi-cabc-off-command = [15 01 00 00 10 00 02 55 80
										05 01 00 00 10 00 02 29 00];
		qcom,mdss-dsi-cabc-ui-command = [15 01 00 00 10 00 02 55 81
										05 01 00 00 10 00 02 29 00];
		qcom,mdss-dsi-cabc-still-image-command = [15 01 00 00 10 00 02 55 82
												  05 01 00 00 10 00 02 29 00];
		qcom,mdss-dsi-cabc-video-command = [15 01 00 00 10 00 02 55 83
										    05 01 00 00 10 00 02 29 00];
		/*caven.han add end*/
		qcom,mdss-dsi-h-sync-pulse = <1>;
		qcom,mdss-dsi-traffic-mode = "burst_mode";
		qcom,mdss-dsi-lane-map = <0>;
		qcom,mdss-dsi-bllp-eof-power-mode;
		qcom,mdss-dsi-bllp-power-mode;
		qcom,mdss-dsi-lane-0-state;
		qcom,mdss-dsi-lane-1-state;
		qcom,mdss-dsi-lane-2-state;
		qcom,mdss-dsi-lane-3-state;
//		qcom,mdss-dsi-panel-timings = [93 1F 17 00 2F 2E 1C 21 26 03 04 00];
//		qcom,mdss-dsi-panel-timings = [8B 1E 1C 00 44 44 1C 22 19 03 04 00];
		qcom,mdss-dsi-panel-timings = [8B 1E 1C 00 44 7C 1C 22 19 03 04 00];
		qcom,mdss-dsi-t-clk-post = <0x20>;
		qcom,mdss-dsi-t-clk-pre = <0x2c>;
		qcom,mdss-dsi-bl-min-level = <1>;
		qcom,mdss-dsi-bl-max-level = <255>;
		qcom,mdss-dsi-dma-trigger = <4>;
		qcom,mdss-dsi-mdp-trigger = <0>;
		qcom,mdss-dsi-bl-pmic-control-type = "bl_ctrl_wled";
		qcom,mdss-dsi-reset-sequence = <1 10>, <0 1>, <1 15>;
		qcom,mdss-pan-physical-width-dimension = <59>;
		qcom,mdss-pan-physical-height-dimension = <104>;
	};
};
