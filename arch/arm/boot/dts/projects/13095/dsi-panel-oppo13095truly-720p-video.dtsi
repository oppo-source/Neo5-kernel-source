/* Copyright (c) 2013, The Linux Foundation. All rights reserved.
 *
 * This program is free software; you can redistribute it and/or modify
 * it under the terms of the GNU General Public License version 2 and
 * only version 2 as published by the Free Software Foundation.
 *
 * This program is distributed in the hope that it will be useful,
 * but WITHOUT ANY WARRANTY; without even the implied warranty of
 * MERCHANTABILITY or FITNESS FOR A PARTICULAR PURPOSE.  See the
 * GNU General Public License for more details.
 */

/*---------------------------------------------------------------------------
 * This file is autogenerated file using gcdb parser. Please do not edit it.
 * Update input XML file to add a new entry or update variable in this file
 * VERSION = "1.0"
 *---------------------------------------------------------------------------*/
&mdss_mdp {
	dsi_oppo13095truly_720p_video: qcom,mdss_dsi_oppo13095truly_720p_video {
		qcom,mdss-dsi-panel-name = "oppo13095truly 720p video mode dsi panel";
		qcom,mdss-dsi-panel-controller = <&mdss_dsi0>;
		qcom,mdss-dsi-panel-type = "dsi_video_mode";
		qcom,mdss-dsi-panel-destination = "display_1";
		qcom,mdss-dsi-panel-framerate = <60>;
		qcom,mdss-dsi-virtual-channel-id = <0>;
		qcom,mdss-dsi-stream = <0>;
		qcom,mdss-dsi-panel-width = <720>;
		qcom,mdss-dsi-panel-height = <1280>;
		qcom,mdss-dsi-h-front-porch = <146>;
		qcom,mdss-dsi-h-back-porch = <153>;
		qcom,mdss-dsi-h-pulse-width = <16>;
		qcom,mdss-dsi-h-sync-skew = <0>;
		qcom,mdss-dsi-v-back-porch = <15>;
		qcom,mdss-dsi-v-front-porch = <14>;
		qcom,mdss-dsi-v-pulse-width = <1>;
		qcom,mdss-dsi-h-left-border = <0>;
		qcom,mdss-dsi-h-right-border = <0>;
		qcom,mdss-dsi-v-top-border = <0>;
		qcom,mdss-dsi-v-bottom-border = <0>;
		qcom,mdss-dsi-bpp = <24>;
		qcom,mdss-dsi-color-order = <0>;
		qcom,mdss-dsi-underflow-color = <0xff>;
		qcom,mdss-dsi-border-color = <0>;
		qcom,mdss-dsi-on-command = [39 01 00 00 00 00 05 FF AA 55 A5 80
39 01 00 00 00 00 02 F4 00
39 01 00 00 00 00 05 FF AA 55 A5 80
39 01 00 00 00 00 03 6F 11 00
39 01 00 00 00 00 03 F7 20 00
39 01 00 00 00 00 02 6F 01
39 01 00 00 00 00 05 FF AA 55 A5 80
39 01 00 00 00 00 02 6F 01
39 01 00 00 00 00 02 F9 46
39 01 00 00 00 00 06 F0 55 AA 52 08 00
39 01 00 00 00 00 02 B1 61
39 01 00 00 00 00 02 B2 25
39 01 00 00 00 00 02 B6 16
39 01 00 00 00 00 05 B8 01 02 0F 02
39 01 00 00 00 00 06 BD 02 67 20 20 00
39 01 00 00 00 00 06 BE 02 67 20 20 03
39 01 00 00 00 00 05 BF 87 78 01 80
39 01 00 00 00 00 11 CC 00 f0 ff 00 00 00 00 00 00 00 00 00 00 00 00 05
39 01 00 00 00 00 0D D7 28 28 00 00 00 00 00 00 00 00 00 00
39 01 00 00 00 00 0E D8 00 00 00 00 00 00 00 00 00 00 28 28 00
39 01 00 00 00 00 06 F0 55 AA 52 08 01
39 01 00 00 00 00 03 B3 20 20
39 01 00 00 00 00 03 B4 18 18
39 01 00 00 00 00 03 B9 35 35
39 01 00 00 00 00 03 BA 35 35
39 01 00 00 00 00 02 CA 80
39 01 00 00 00 00 02 BE 86
39 01 00 00 00 00 02 BF 86
39 01 00 00 00 00 02 D2 86
39 01 00 00 00 00 02 D3 86
39 01 00 00 00 00 06 F0 55 AA 52 08 03
39 01 00 00 00 00 03 B0 20 00
39 01 00 00 00 00 03 B1 20 00
39 01 00 00 00 00 06 B2 15 00 60 00 00
39 01 00 00 00 00 06 B3 15 00 60 00 00
39 01 00 00 00 00 06 B4 05 00 60 00 00
39 01 00 00 00 00 06 B5 05 00 60 00 00
39 01 00 00 00 00 06 BA 44 10 60 01 90
39 01 00 00 00 00 06 BB 44 10 60 01 90
39 01 00 00 00 00 06 BC 44 10 60 01 90
39 01 00 00 00 00 06 BD 44 10 60 01 90
39 01 00 00 00 00 05 C0 00 34 00 00
39 01 00 00 00 00 05 C1 00 00 34 00
39 01 00 00 00 00 05 C2 00 00 34 00
39 01 00 00 00 00 05 C3 00 00 34 00
39 01 00 00 00 00 02 C4 60
39 01 00 00 00 00 02 C5 C0
39 01 00 00 00 00 02 C6 00
39 01 00 00 00 00 02 C7 00
39 01 00 00 00 00 06 F0 55 AA 52 08 05
39 01 00 00 00 00 03 B0 17 06
39 01 00 00 00 00 03 B1 17 06
39 01 00 00 00 00 03 B2 17 06
39 01 00 00 00 00 03 B3 17 06
39 01 00 00 00 00 03 B4 17 06
39 01 00 00 00 00 03 B5 17 06
39 01 00 00 00 00 03 B6 14 03
39 01 00 00 00 00 03 B7 00 00
39 01 00 00 00 00 02 B8 0C
39 01 00 00 00 00 03 B9 00 03
39 01 00 00 00 00 03 BA 00 01
39 01 00 00 00 00 03 BB 0A 03
39 01 00 00 00 00 03 BC 02 03
39 01 00 00 00 00 06 BD 03 03 01 03 03
39 01 00 00 00 00 02 C0 07
39 01 00 00 00 00 02 C1 06
39 01 00 00 00 00 02 C2 A6
39 01 00 00 00 00 02 C3 05
39 01 00 00 00 00 02 C4 A6
39 01 00 00 00 00 02 C5 A6
39 01 00 00 00 00 02 C6 A6
39 01 00 00 00 00 02 C7 A6
39 01 00 00 00 00 03 C8 05 20
39 01 00 00 00 00 03 C9 04 20
39 01 00 00 00 00 03 CA 01 25
39 01 00 00 00 00 03 CB 01 60
39 01 00 00 00 00 04 CC 00 00 01
39 01 00 00 00 00 04 CD 00 00 01
39 01 00 00 00 00 04 CE 00 00 02
39 01 00 00 00 00 04 CF 00 00 02
39 01 00 00 00 00 08 D0 00 00 00 00 00 00 00
39 01 00 00 00 00 06 D1 00 35 01 07 10
39 01 00 00 00 00 06 D2 10 35 02 03 10
39 01 00 00 00 00 06 D3 20 00 43 07 10
39 01 00 00 00 00 06 D4 30 00 43 07 10
39 01 00 00 00 00 0C D5 00 00 00 00 00 00 00 00 00 00 00
39 01 00 00 00 00 0C D6 00 00 00 00 00 00 00 00 00 00 00
39 01 00 00 00 00 0C D7 00 00 00 00 00 00 00 00 00 00 00
39 01 00 00 00 00 06 D8 00 00 00 00 00
39 01 00 00 00 00 02 E5 06
39 01 00 00 00 00 02 E6 06
39 01 00 00 00 00 02 E7 06
39 01 00 00 00 00 02 E8 06
39 01 00 00 00 00 02 E9 06
39 01 00 00 00 00 02 EA 06
39 01 00 00 00 00 02 EB 00
39 01 00 00 00 00 02 EC 00
39 01 00 00 00 00 02 ED 30
39 01 00 00 00 00 06 F0 55 AA 52 08 06
39 01 00 00 00 00 03 B0 31 31
39 01 00 00 00 00 03 B1 31 31
39 01 00 00 00 00 03 B2 2D 2E
39 01 00 00 00 00 03 B3 31 34
39 01 00 00 00 00 03 B4 29 2A
39 01 00 00 00 00 03 B5 10 13
39 01 00 00 00 00 03 B6 12 11
39 01 00 00 00 00 03 B7 00 01
39 01 00 00 00 00 03 B8 08 31
39 01 00 00 00 00 03 B9 31 31
39 01 00 00 00 00 03 BA 31 31
39 01 00 00 00 00 03 BB 31 08
39 01 00 00 00 00 03 BC 03 02
39 01 00 00 00 00 03 BD 17 18
39 01 00 00 00 00 03 BE 19 16
39 01 00 00 00 00 06 D8 00 00 00 00 00
39 01 00 00 00 00 06 D9 00 00 00 00 00
39 01 00 00 00 00 03 E5 00 00
39 01 00 00 00 00 02 E7 00
39 01 00 00 00 00 02 6F 01
39 01 00 00 00 00 02 F9 46
39 01 00 00 00 00 02 6F 11
39 01 00 00 00 00 02 F3 01
39 01 00 00 01 00 02 55 80
15 01 00 00 00 00 02 35 00
39 01 00 00 00 00 02 6F 12
39 01 00 00 00 00 02 F3 80
39 01 00 00 00 00 02 6F 0C
39 01 00 00 00 00 05 F3 FF 0F 00 00
05 01 00 00 96 00 02 11 00
39 01 00 00 00 00 02 6F 12
39 01 00 00 00 00 02 F3 00
39 01 00 00 00 00 06 F0 55 AA 52 08 01
39 01 00 00 00 00 03 BC 8F 00
39 01 00 00 00 00 03 BD 8F 00
39 01 00 00 00 00 06 F0 55 AA 52 08 02
39 01 00 00 00 00 02 EE 00
39 01 00 00 00 00 11 B0 00 3A 00 4D 00 56 00 6B 00 76 00 99 00 AD 00 D3
39 01 00 00 00 00 11 B1 00 F7 01 2E 01 5E 01 A7 01 E6 01 E8 02 22 02 64
39 01 00 00 00 00 11 B2 02 8C 02 C1 02 E1 03 04 03 46 03 89 03 AA 03 CC
39 01 00 00 00 00 05 B3 03 EE 03 FF
39 01 00 00 00 00 11 B4 00 76 00 83 00 88 00 99 00 A2 00 BD 00 CD 00 ED
39 01 00 00 00 00 11 B5 01 0D 01 3F 01 6A 01 B0 01 ED 01 EF 02 28 02 6A
39 01 00 00 00 00 11 B6 02 95 02 CD 02 F2 03 24 03 5E 03 98 03 B5 03 D2
39 01 00 00 00 00 05 B7 03 F0 03 FF
39 01 00 00 00 00 11 B8 00 64 00 6F 00 75 00 86 00 8F 00 AB 00 BC 00 DD
39 01 00 00 00 00 11 B9 00 FE 01 33 01 60 01 A8 01 E7 01 E9 02 24 02 68
39 01 00 00 00 00 11 BA 02 95 02 D5 03 05 03 71 03 96 03 BC 03 CF 03 E2
39 01 00 00 00 00 05 BB 03 F5 03 FF
39 01 00 00 00 00 11 BC 00 3A 00 4D 00 56 00 6B 00 76 00 99 00 AD 00 D3
39 01 00 00 00 00 11 BD 00 F7 01 2E 01 5E 01 A7 01 E6 01 E8 02 22 02 64
39 01 00 00 00 00 11 BE 02 8C 02 C1 02 E1 03 04 03 46 03 89 03 AA 03 CC
39 01 00 00 00 00 05 BF 03 EE 03 FF
39 01 00 00 00 00 11 C0 00 76 00 83 00 88 00 99 00 A2 00 BD 00 CD 00 ED
39 01 00 00 00 00 11 C1 01 0D 01 3F 01 6A 01 B0 01 ED 01 EF 02 28 02 6A
39 01 00 00 00 00 11 C2 02 95 02 CD 02 F2 03 24 03 5E 03 98 03 B5 03 D2
39 01 00 00 00 00 05 C3 03 F0 03 FF
39 01 00 00 00 00 11 C4 00 64 00 6F 00 75 00 86 00 8F 00 AB 00 BC 00 DD
39 01 00 00 00 00 11 C5 00 FE 01 33 01 60 01 A8 01 E7 01 E9 02 24 02 68
39 01 00 00 00 00 11 C6 02 95 02 D5 03 05 03 71 03 96 03 BC 03 CF 03 E2
39 01 00 00 00 00 05 C7 03 F5 03 FF
39 01 00 00 00 00 05 FF AA 55 A5 80
39 01 00 00 00 00 02 6F 1E
39 01 00 00 00 00 02 FA 20
39 01 00 00 00 00 02 6F 1E
39 01 00 00 00 00 02 FA 00
39 01 00 00 00 00 02 6F 1F
39 01 00 00 00 00 02 FA 00
39 01 00 00 00 00 02 6F 11
39 01 00 00 00 00 02 F3 01
05 01 00 00 40 00 02 29 00];
		qcom,mdss-dsi-on-command-cabc = [39 01 00 00 00 00 05 FF AA 55 A5 80
39 01 00 00 00 00 02 F4 00
39 01 00 00 00 00 05 FF AA 55 A5 80
39 01 00 00 00 00 03 6F 11 00
39 01 00 00 00 00 03 F7 20 00
39 01 00 00 00 00 02 6F 01
39 01 00 00 00 00 05 FF AA 55 A5 80
39 01 00 00 00 00 02 6F 01
39 01 00 00 00 00 02 F9 46
39 01 00 00 00 00 06 F0 55 AA 52 08 00
39 01 00 00 00 00 02 B1 61
39 01 00 00 00 00 02 B2 25
39 01 00 00 00 00 02 B6 16
39 01 00 00 00 00 05 B8 01 02 0F 02
39 01 00 00 00 00 06 BD 02 67 20 20 00
39 01 00 00 00 00 06 BE 02 67 20 20 03
39 01 00 00 00 00 05 BF 87 78 01 80
39 01 00 00 00 00 11 CC 00 f0 ff 00 00 00 00 00 00 00 00 00 00 00 00 05
39 01 00 00 00 00 0D D7 28 28 00 00 00 00 00 00 00 00 00 00
39 01 00 00 00 00 0E D8 00 00 00 00 00 00 00 00 00 00 28 28 00
39 01 00 00 00 00 06 F0 55 AA 52 08 01
39 01 00 00 00 00 03 B3 20 20
39 01 00 00 00 00 03 B4 18 18
39 01 00 00 00 00 03 B9 35 35
39 01 00 00 00 00 03 BA 35 35
39 01 00 00 00 00 02 CA 80
39 01 00 00 00 00 02 BE 86
39 01 00 00 00 00 02 BF 86
39 01 00 00 00 00 02 D2 86
39 01 00 00 00 00 02 D3 86
39 01 00 00 00 00 06 F0 55 AA 52 08 03
39 01 00 00 00 00 03 B0 20 00
39 01 00 00 00 00 03 B1 20 00
39 01 00 00 00 00 06 B2 15 00 60 00 00
39 01 00 00 00 00 06 B3 15 00 60 00 00
39 01 00 00 00 00 06 B4 05 00 60 00 00
39 01 00 00 00 00 06 B5 05 00 60 00 00
39 01 00 00 00 00 06 BA 44 10 60 01 90
39 01 00 00 00 00 06 BB 44 10 60 01 90
39 01 00 00 00 00 06 BC 44 10 60 01 90
39 01 00 00 00 00 06 BD 44 10 60 01 90
39 01 00 00 00 00 05 C0 00 34 00 00
39 01 00 00 00 00 05 C1 00 00 34 00
39 01 00 00 00 00 05 C2 00 00 34 00
39 01 00 00 00 00 05 C3 00 00 34 00
39 01 00 00 00 00 02 C4 60
39 01 00 00 00 00 02 C5 C0
39 01 00 00 00 00 02 C6 00
39 01 00 00 00 00 02 C7 00
39 01 00 00 00 00 06 F0 55 AA 52 08 05
39 01 00 00 00 00 03 B0 17 06
39 01 00 00 00 00 03 B1 17 06
39 01 00 00 00 00 03 B2 17 06
39 01 00 00 00 00 03 B3 17 06
39 01 00 00 00 00 03 B4 17 06
39 01 00 00 00 00 03 B5 17 06
39 01 00 00 00 00 03 B6 14 03
39 01 00 00 00 00 03 B7 00 00
39 01 00 00 00 00 02 B8 0C
39 01 00 00 00 00 03 B9 00 03
39 01 00 00 00 00 03 BA 00 01
39 01 00 00 00 00 03 BB 0A 03
39 01 00 00 00 00 03 BC 02 03
39 01 00 00 00 00 06 BD 03 03 01 03 03
39 01 00 00 00 00 02 C0 07
39 01 00 00 00 00 02 C1 06
39 01 00 00 00 00 02 C2 A6
39 01 00 00 00 00 02 C3 05
39 01 00 00 00 00 02 C4 A6
39 01 00 00 00 00 02 C5 A6
39 01 00 00 00 00 02 C6 A6
39 01 00 00 00 00 02 C7 A6
39 01 00 00 00 00 03 C8 05 20
39 01 00 00 00 00 03 C9 04 20
39 01 00 00 00 00 03 CA 01 25
39 01 00 00 00 00 03 CB 01 60
39 01 00 00 00 00 04 CC 00 00 01
39 01 00 00 00 00 04 CD 00 00 01
39 01 00 00 00 00 04 CE 00 00 02
39 01 00 00 00 00 04 CF 00 00 02
39 01 00 00 00 00 08 D0 00 00 00 00 00 00 00
39 01 00 00 00 00 06 D1 00 35 01 07 10
39 01 00 00 00 00 06 D2 10 35 02 03 10
39 01 00 00 00 00 06 D3 20 00 43 07 10
39 01 00 00 00 00 06 D4 30 00 43 07 10
39 01 00 00 00 00 0C D5 00 00 00 00 00 00 00 00 00 00 00
39 01 00 00 00 00 0C D6 00 00 00 00 00 00 00 00 00 00 00
39 01 00 00 00 00 0C D7 00 00 00 00 00 00 00 00 00 00 00
39 01 00 00 00 00 06 D8 00 00 00 00 00
39 01 00 00 00 00 02 E5 06
39 01 00 00 00 00 02 E6 06
39 01 00 00 00 00 02 E7 06
39 01 00 00 00 00 02 E8 06
39 01 00 00 00 00 02 E9 06
39 01 00 00 00 00 02 EA 06
39 01 00 00 00 00 02 EB 00
39 01 00 00 00 00 02 EC 00
39 01 00 00 00 00 02 ED 30
39 01 00 00 00 00 06 F0 55 AA 52 08 06
39 01 00 00 00 00 03 B0 31 31
39 01 00 00 00 00 03 B1 31 31
39 01 00 00 00 00 03 B2 2D 2E
39 01 00 00 00 00 03 B3 31 34
39 01 00 00 00 00 03 B4 29 2A
39 01 00 00 00 00 03 B5 10 13
39 01 00 00 00 00 03 B6 12 11
39 01 00 00 00 00 03 B7 00 01
39 01 00 00 00 00 03 B8 08 31
39 01 00 00 00 00 03 B9 31 31
39 01 00 00 00 00 03 BA 31 31
39 01 00 00 00 00 03 BB 31 08
39 01 00 00 00 00 03 BC 03 02
39 01 00 00 00 00 03 BD 17 18
39 01 00 00 00 00 03 BE 19 16
39 01 00 00 00 00 06 D8 00 00 00 00 00
39 01 00 00 00 00 06 D9 00 00 00 00 00
39 01 00 00 00 00 03 E5 00 00
39 01 00 00 00 00 02 E7 00
39 01 00 00 00 00 02 6F 01
39 01 00 00 00 00 02 F9 46
39 01 00 00 00 00 02 6F 11
39 01 00 00 00 00 02 F3 01
39 01 00 00 00 00 06 F0 55 AA 52 08 00
39 01 00 00 00 00 03 D9 01 01
39 01 00 00 01 00 02 51 ff
39 01 00 00 01 00 02 55 83
15 01 00 00 01 00 02 53 2c
15 01 00 00 00 00 02 35 00
39 01 00 00 00 00 02 6F 12
39 01 00 00 00 00 02 F3 80
39 01 00 00 00 00 02 6F 0C
39 01 00 00 00 00 05 F3 FF 0F 00 00
05 01 00 00 96 00 02 11 00
39 01 00 00 00 00 02 6F 12
39 01 00 00 00 00 02 F3 00
39 01 00 00 00 00 06 F0 55 AA 52 08 01
39 01 00 00 00 00 03 BC 8F 00
39 01 00 00 00 00 03 BD 8F 00
39 01 00 00 00 00 06 F0 55 AA 52 08 02
39 01 00 00 00 00 02 EE 00
39 01 00 00 00 00 11 B0 00 3A 00 4D 00 56 00 6B 00 76 00 99 00 AD 00 D3
39 01 00 00 00 00 11 B1 00 F7 01 2E 01 5E 01 A7 01 E6 01 E8 02 22 02 64
39 01 00 00 00 00 11 B2 02 8C 02 C1 02 E1 03 04 03 46 03 89 03 AA 03 CC
39 01 00 00 00 00 05 B3 03 EE 03 FF
39 01 00 00 00 00 11 B4 00 76 00 83 00 88 00 99 00 A2 00 BD 00 CD 00 ED
39 01 00 00 00 00 11 B5 01 0D 01 3F 01 6A 01 B0 01 ED 01 EF 02 28 02 6A
39 01 00 00 00 00 11 B6 02 95 02 CD 02 F2 03 24 03 5E 03 98 03 B5 03 D2
39 01 00 00 00 00 05 B7 03 F0 03 FF
39 01 00 00 00 00 11 B8 00 64 00 6F 00 75 00 86 00 8F 00 AB 00 BC 00 DD
39 01 00 00 00 00 11 B9 00 FE 01 33 01 60 01 A8 01 E7 01 E9 02 24 02 68
39 01 00 00 00 00 11 BA 02 95 02 D5 03 05 03 71 03 96 03 BC 03 CF 03 E2
39 01 00 00 00 00 05 BB 03 F5 03 FF
39 01 00 00 00 00 11 BC 00 3A 00 4D 00 56 00 6B 00 76 00 99 00 AD 00 D3
39 01 00 00 00 00 11 BD 00 F7 01 2E 01 5E 01 A7 01 E6 01 E8 02 22 02 64
39 01 00 00 00 00 11 BE 02 8C 02 C1 02 E1 03 04 03 46 03 89 03 AA 03 CC
39 01 00 00 00 00 05 BF 03 EE 03 FF
39 01 00 00 00 00 11 C0 00 76 00 83 00 88 00 99 00 A2 00 BD 00 CD 00 ED
39 01 00 00 00 00 11 C1 01 0D 01 3F 01 6A 01 B0 01 ED 01 EF 02 28 02 6A
39 01 00 00 00 00 11 C2 02 95 02 CD 02 F2 03 24 03 5E 03 98 03 B5 03 D2
39 01 00 00 00 00 05 C3 03 F0 03 FF
39 01 00 00 00 00 11 C4 00 64 00 6F 00 75 00 86 00 8F 00 AB 00 BC 00 DD
39 01 00 00 00 00 11 C5 00 FE 01 33 01 60 01 A8 01 E7 01 E9 02 24 02 68
39 01 00 00 00 00 11 C6 02 95 02 D5 03 05 03 71 03 96 03 BC 03 CF 03 E2
39 01 00 00 00 00 05 C7 03 F5 03 FF
39 01 00 00 00 00 05 FF AA 55 A5 80
39 01 00 00 00 00 02 6F 1E
39 01 00 00 00 00 02 FA 20
39 01 00 00 00 00 02 6F 1E
39 01 00 00 00 00 02 FA 00
39 01 00 00 00 00 02 6F 1F
39 01 00 00 00 00 02 FA 00
39 01 00 00 00 00 02 6F 11
39 01 00 00 00 00 02 F3 01
05 01 00 00 40 00 02 29 00];
		qcom,mdss-dsi-off-command = [05 01 00 00 14 00 02 28 00
					05 01 00 00 78 00 02 10 00];
		qcom,mdss-dsi-on-command-state = "dsi_lp_mode";
		qcom,mdss-dsi-off-command-state = "dsi_hs_mode";
				/*caven.han add begin for CABC*/
		qcom,mdss-dsi-cabc-off-command = [15 01 00 00 10 00 02 55 80
										05 01 00 00 10 00 02 29 00];
		qcom,mdss-dsi-cabc-ui-command = [15 01 00 00 10 00 02 55 81
										05 01 00 00 10 00 02 29 00];
		qcom,mdss-dsi-cabc-still-image-command = [15 01 00 00 10 00 02 55 82
												  05 01 00 00 10 00 02 29 00];
		qcom,mdss-dsi-cabc-video-command = [15 01 00 00 10 00 02 55 83
										    05 01 00 00 10 00 02 29 00];
		/*caven.han add end*/
		qcom,mdss-dsi-h-sync-pulse = <1>;
		qcom,mdss-dsi-traffic-mode = "burst_mode";
		qcom,mdss-dsi-lane-map = <0>;
		qcom,mdss-dsi-bllp-eof-power-mode;
		qcom,mdss-dsi-bllp-power-mode;
		qcom,mdss-dsi-lane-0-state;
		qcom,mdss-dsi-lane-1-state;
		qcom,mdss-dsi-lane-2-state;
		qcom,mdss-dsi-lane-3-state;
//		qcom,mdss-dsi-panel-timings = [93 1F 17 00 2F 2E 1C 21 26 03 04 00];
//		qcom,mdss-dsi-panel-timings = [8B 1E 1C 00 44 44 1C 22 19 03 04 00];
		qcom,mdss-dsi-panel-timings = [8B 1E 1C 00 44 7C 1C 22 19 03 04 00];
		qcom,mdss-dsi-t-clk-post = <0x20>;
		qcom,mdss-dsi-t-clk-pre = <0x2c>;
		qcom,mdss-dsi-bl-min-level = <1>;
		qcom,mdss-dsi-bl-max-level = <255>;
		qcom,mdss-dsi-dma-trigger = <4>;
		qcom,mdss-dsi-mdp-trigger = <0>;
		qcom,mdss-dsi-bl-pmic-control-type = "bl_ctrl_wled";
		qcom,mdss-dsi-reset-sequence = <1 10>, <0 1>, <1 15>;
		qcom,mdss-pan-physical-width-dimension = <59>;
		qcom,mdss-pan-physical-height-dimension = <104>;
	};
};
